## app/src/aliro/platform/nfc/nxp/Kconfig
```kconfig
#
# Copyright (c) 2025 Nordic Semiconductor ASA
#
# SPDX-License-Identifier: LicenseRef-Nordic-5-Clause
#

rsource "Kconfig.NxpNfcRdLib.defconfig"

if NFC_DRIVER_NXP

menu "NFC"

config NCS_NXP_DISCOVERY_LOOP_LPCD
	bool "Low power card detection (LPCD)"
	default y
	help
	  Configure and enable LPCD in the discovery loop to reduce power
	  consumption while waiting for a tag.

module = DOOR_LOCK_NXPNFCRDLIB
module-str = DOOR_LOCK_NXPNFCRDLIB
module-dep = LOG
module-help = Enables Door Lock NFC NxpNfcRdLib log messages.
source "$(ZEPHYR_BASE)/subsys/logging/Kconfig.template.log_config"

endmenu # NFC

endif # NFC_DRIVER_NXP
```

## app/src/aliro/platform/nfc/nxp/Kconfig.NxpNfcRdLib.defconfig
```kconfig
#
# Copyright (c) 2025 Nordic Semiconductor ASA
#
# SPDX-License-Identifier: LicenseRef-Nordic-5-Clause
#

config NFC_DRIVER_NXP
	default y

config NFC_NXP_PAL_I14443P3A
	default y

config NFC_NXP_PAL_I14443P4A
	default y

config NFC_NXP_PAL_I14443P4
	default y
```

## app/src/at_command/Kconfig
```kconfig
#
# Copyright (c) 2026 Nordic Semiconductor ASA
#
# SPDX-License-Identifier: LicenseRef-Nordic-5-Clause
#

config ALIRO_AT_MODULE
  bool "Aliro AT Module"
  select MATTER_ON_EXTERNAL_MCU
  select AT_PARSER
  help
    Enables the AT Module

config ALIRO_AT_HOST
  bool "Door lock AT Host"
  select ALIRO_ON_EXTERNAL_MCU
  help
    Enables the AT Host

config ALIRO_AT_TRANSPORT_SERIAL
  bool "AT serial transport"
  default y
  depends on SERIAL
  select UART_ASYNC_API
  select SHELL_ASYNC_API
  help
    Use serial transport for AT (async UART with TX/RX FIFOs).

config ALIRO_AT_COMMAND_BUF_SIZE
  int "UART buffer size for TX and RX"
  default 256
  range 64 4096
  help
    Size of each UART TX and RX buffer in bytes.

config ALIRO_AT_RX_EVENT_QUEUE_SIZE
  int "RX event message queue size"
  default 8
  range 4 32
  help
    Number of RX events that can be queued for at_process processing.

config ALIRO_AT_TRANSPORT_BLE
  bool "AT BLE transport"
  help
    Use BLE transport for AT
```

## drivers/nfc/nxp/Kconfig
```kconfig
#
# Copyright (c) 2025 Nordic Semiconductor ASA
#
# SPDX-License-Identifier: LicenseRef-Nordic-5-Clause
#

menuconfig NFC_DRIVER_NXP
	bool "NXP PN series device driver"
	select EVENTS
	help
	  This option enables the NXP PN series device driver for NFC.

if NFC_DRIVER_NXP

rsource "Kconfig.defconfig"

choice
	prompt "Select NXP driver"
	default PN5190_DRV

config PN5190_DRV
	bool "NFC PN5190 driver"
	select SPI

config PN5180_DRV
	select SPI
	bool "NFC PN5180 driver"

endchoice

config NFC_NXP_HW_TARGET
	bool "NXP HAL target (listen) mode"
	help
	  Enable NXP Reader Library HAL target mode support (listen mode /
	  card emulation). Corresponds to NXPBUILD__PHHAL_HW_TARGET.

config NFC_NXP_PAL_I14443P3A
	bool "PAL ISO 14443-3A (Type A Layer 3)"
	help
	  Include the NXP Reader Library PAL ISO 14443-3A software component.
	  Corresponds to NXPBUILD__PHPAL_I14443P3A_SW.

config NFC_NXP_PAL_I14443P3B
	bool "PAL ISO 14443-3B (Type B Layer 3)"
	help
	  Include the NXP Reader Library PAL ISO 14443-3B software component.
	  Corresponds to NXPBUILD__PHPAL_I14443P3B_SW.

config NFC_NXP_PAL_I14443P4A
	bool "PAL ISO 14443-4A (Type A Layer 4 activation)"
	help
	  Include the NXP Reader Library PAL ISO 14443-4A software component.
	  Corresponds to NXPBUILD__PHPAL_I14443P4A_SW.

config NFC_NXP_PAL_I14443P4
	bool "PAL ISO 14443-4 (Layer 4 transport)"
	help
	  Include the NXP Reader Library PAL ISO 14443-4 software component.
	  Corresponds to NXPBUILD__PHPAL_I14443P4_SW.

config NFC_NXP_PAL_I14443P4MC
	bool "PAL ISO 14443-4 Card Mode (HCE / card emulation)"
	help
	  Include the NXP Reader Library PAL ISO 14443-4 card mode software
	  component and HCE T4T support. Corresponds to
	  NXPBUILD__PHPAL_I14443P4MC_SW.

config NFC_NXP_PAL_MIFARE
	bool "PAL MIFARE product"
	help
	  Include the NXP Reader Library PAL MIFARE product software component.
	  Corresponds to NXPBUILD__PHPAL_MIFARE_SW.

config NFC_NXP_PAL_FELICA
	bool "PAL FeliCa"
	help
	  Include the NXP Reader Library PAL FeliCa software component.
	  Corresponds to NXPBUILD__PHPAL_FELICA_SW.

config NFC_NXP_PAL_SLI15693
	bool "PAL ISO 15693 (Type V / SLI15693)"
	help
	  Include the NXP Reader Library PAL ISO 15693 software component.
	  Corresponds to NXPBUILD__PHPAL_SLI15693_SW.

config NFC_NXP_PAL_I18000P3M3
	bool "PAL ISO 18000-3 Mode 3"
	help
	  Include the NXP Reader Library PAL ISO 18000-3 Mode 3 software
	  component. Corresponds to NXPBUILD__PHPAL_I18000P3M3_SW.

config NFC_NXP_PAL_I18092MPI
	bool "PAL ISO 18092 (P2P Initiator)"
	help
	  Include the NXP Reader Library PAL ISO 18092 initiator mode (P2P)
	  software component. Corresponds to NXPBUILD__PHPAL_I18092MPI_SW.

config NFC_NXP_PAL_I18092MT
	bool "PAL ISO 18092 (P2P Target)"
	help
	  Include the NXP Reader Library PAL ISO 18092 target mode (P2P)
	  software component. Corresponds to NXPBUILD__PHPAL_I18092MT_SW.

config NFC_NXP_AL_T1T
	bool "AL Type 1 Tag (T1T / Topaz)"
	default n
	help
	  Include the NXP Reader Library AL Type 1 Tag software component.
	  Corresponds to NXPBUILD__PHAL_T1T_SW.

config NFC_NXP_AL_TOP
	bool "AL Tag Operations (phalTop / NDEF)"
	default n
	help
	  Include the NXP Reader Library Tag Operations (Top) software
	  component for NDEF read/write across tag types. Corresponds to
	  NXPBUILD__PHAL_TOP_SW.

config NFC_NXP_KEYSTORE
	bool "KeyStore component (phKeyStore)"
	default y if NFC_NXP_PAL_MIFARE
	default n
	help
	  Include the NXP Reader Library KeyStore software component.
	  Required for MIFARE secure authentication. Corresponds to
	  NXPBUILD__PH_KEYSTORE_SW.

config NFC_NXP_CRYPTOSYM
	bool "Symmetric crypto component (phCryptoSym)"
	default y if NFC_NXP_PAL_MIFARE
	default n
	depends on NFC_NXP_KEYSTORE
	help
	  Include the NXP Reader Library symmetric crypto software
	  component. Corresponds to NXPBUILD__PH_CRYPTOSYM_SW.

config NFC_NXP_CRYPTORNG
	bool "Crypto RNG component (phCryptoRng)"
	default y if NFC_NXP_CRYPTOSYM
	default n
	depends on NFC_NXP_CRYPTOSYM
	help
	  Include the NXP Reader Library crypto RNG software component.
	  Corresponds to NXPBUILD__PH_CRYPTORNG_SW.

config NFC_NXP_LLCP
	bool "LLCP link layer (phlnLlcp)"
	default y if NFC_NXP_PAL_I18092MPI || NFC_NXP_PAL_I18092MT
	default n
	help
	  Include the NXP Reader Library LLCP software component for
	  NFC-DEP P2P. Corresponds to NXPBUILD__PHLN_LLCP_SW.

config NFC_NXP_NFCLIB_EMVCO
	bool "NFC Library EMVCo profile"
	help
	  Enable the EMVCo profile of the NXP NFC Library simplified API.
	  Corresponds to NXPBUILD__PH_NFCLIB_EMVCO.

config NFC_NXP_DEBUG_HELPERS
	bool "NXP NFC debug print helpers"
	default y
	help
	  Enable shared debug print helpers for NXP NFC samples and
	  applications.

module = NFC
module-str = NFC_DRV
module-dep = LOG
module-help = Enables driver log messages.
source "$(ZEPHYR_BASE)/subsys/logging/Kconfig.template.log_config"

endif # NFC_DRIVER_NXP
```

## drivers/nfc/nxp/Kconfig.defconfig
```kconfig
#
# Copyright (c) 2025 Nordic Semiconductor ASA
#
# SPDX-License-Identifier: LicenseRef-Nordic-5-Clause
#

config SPI
	default y if NFC_DRIVER_NXP
```

## dts/bindings/nxp,pn5180.yaml
```yaml
# Copyright (c) 2020 Nordic Semiconductor ASA
# SPDX-License-Identifier: LicenseRef-Nordic-5-Clause

description: |
    NXP PN5180 NFC Initiator / HF Reader

compatible: "nxp,pn5180"

include: spi-device.yaml

properties:
    irq-gpios:
      type: phandle-array
      required: true

    reset-gpios:
      type: phandle-array
      required: true

    busy-gpios:
      type: phandle-array
      required: true
```

## dts/bindings/nxp,pn5190.yaml
```yaml
# Copyright (c) 2020 Nordic Semiconductor ASA
# SPDX-License-Identifier: LicenseRef-Nordic-5-Clause

description: |
    NXP PN5190 NFC Initiator / HF Reader

compatible: "nxp,pn5190"

include: spi-device.yaml

properties:
    irq-gpios:
      type: phandle-array
      required: true

    reset-gpios:
      type: phandle-array
      required: true
```

## subsys/aliro_at/Kconfig
```kconfig
#
# Copyright (c) 2026 Nordic Semiconductor ASA
#
# SPDX-License-Identifier: LicenseRef-Nordic-5-Clause
#

menu "AT command"

config ALIRO_AT_MODULE
	bool "Aliro AT Module"
	depends on !CHIP
	select AT_PARSER
	help
	  Enables the AT Module on the reader MCU.

config ALIRO_AT_HOST
	bool "Door lock AT Host"
	help
	  Enables the AT Host on the Matter/host MCU.

config ALIRO_AT_TRANSPORT_SERIAL
	bool "AT serial transport"
	default y
	select SERIAL
	select UART_ASYNC_API
	help
	  Use serial transport for AT (async UART with TX/RX FIFOs).

config ALIRO_AT_UART_PM
	bool "UART power management for AT transport"
	default y
	depends on ALIRO_AT_TRANSPORT_SERIAL && PM_DEVICE
	select GPIO
	help
	  Suspend UART after an idle timeout and wake on RX pin activity.

config ALIRO_AT_UART_IDLE_TIMEOUT_MS
	int "UART idle timeout before power save (ms)"
	default 5000
	depends on ALIRO_AT_UART_PM
	range 100 60000
	help
	  Time without TX/RX activity before UART enters power save mode.

config ALIRO_AT_COMMAND_BUF_SIZE
	int "UART buffer size for TX and RX"
	default 256
	range 64 4096
	help
	  Size of each UART TX and RX buffer in bytes.

config ALIRO_AT_RX_EVENT_QUEUE_SIZE
	int "RX event message queue size"
	default 8
	range 4 32
	help
	  Number of RX events that can be queued for at_process processing.

config ALIRO_AT_TRANSPORT_BLE
	bool "AT BLE transport"
	depends on ALIRO_AT_MODULE || ALIRO_AT_HOST
	help
	  Use BLE transport for AT commands.

	  On the Aliro MCU (AT Module), use together with
	  overlay-aliro_at_transport_ble_module.conf and the bt_nus snippet.

	  On the Matter MCU (AT Host, CONFIG_CHIP), use together with
	  overlay-aliro_at_transport_ble_host.conf in matter-aliro-door-lock-app.

config ALIRO_AT_TRANSPORT_STATE_INDICATOR
	bool "AT transport state indicator"
	default y if ALIRO_AT_TRANSPORT_BLE
	help
	  Enable indication of the AT transport state (connected/disconnected).

config ALIRO_AT_MODULE_MAX_CUSTOM_CMDS
	int "Maximum number of custom AT commands"
	default 16
	depends on ALIRO_AT_MODULE
	help
	  Maximum number of custom AT commands registered via DL_AT_CMD.

config ALIRO_AT_MODULE_MAX_CUSTOM_RSPS
	int "Maximum number of custom AT response handlers"
	default 16
	depends on ALIRO_AT_HOST
	help
	  Maximum number of custom AT response handlers registered via DL_AT_RSP.

endmenu
```

## subsys/internal_zms/Kconfig
```kconfig
#
# Copyright (c) 2026 Nordic Semiconductor ASA
#
# SPDX-License-Identifier: LicenseRef-Nordic-5-Clause
#

menuconfig DOOR_LOCK_INTERNAL_ZMS
	bool "Internal ZMS Storage"
	select ZMS
	select FLASH
	select FLASH_MAP
	select PSA_WANT_GENERATE_RANDOM
	select PSA_WANT_KEY_TYPE_CHACHA20
	select PSA_WANT_ALG_CHACHA20_POLY1305
	select HW_UNIQUE_KEY
	select HW_UNIQUE_KEY_RANDOM
	select HW_UNIQUE_KEY_WRITE_ON_CRYPTO_INIT
	depends on DT_HAS_NORDIC_RRAM_CONTROLLER_ENABLED
	help
	  Enable Internal ZMS Storage.

if DOOR_LOCK_INTERNAL_ZMS

module = DOOR_LOCK_INTERNAL_ZMS
module-str = Door Lock Internal ZMS Storage
source "$(ZEPHYR_BASE)/subsys/logging/Kconfig.template.log_config"

config  DOOR_LOCK_INTERNAL_ZMS_MAX_DATA_SIZE
	int "Maximum data size (bytes)"
	range 1 65535
	default 1024
	help
	  Maximum data size in bytes for the internal ZMS storage objects.

config DOOR_LOCK_INTERNAL_ZMS_ROLLBACK_PROTECTION
	bool "Enable rollback protection"
	depends on SETTINGS
	select TRUSTED_STORAGE if (!PSA_SSF_CRYPTO_CLIENT && !BUILD_WITH_TFM)
	select PSA_PROTECTED_STORAGE if (TRUSTED_STORAGE && !PSA_SSF_CRYPTO_CLIENT && !BUILD_WITH_TFM)
	default y
	help
	  Enable rollback protection for the internal ZMS storage.
	  The device unique ID is stored in PSA Protected Storage (internal flash).

if DOOR_LOCK_INTERNAL_ZMS_ROLLBACK_PROTECTION

config DOOR_LOCK_INTERNAL_ZMS_ROLLBACK_PROTECTION_SETTINGS_PREFIX
	string "Settings prefix"
	default "izm"
	help
		Prefix for the settings keys for the rollback protection.

config DOOR_LOCK_INTERNAL_ZMS_ROLLBACK_PROTECTION_UNIQUE_ID_SIZE
	int "Unique ID size (bytes)"
	default 8
	help
		Size of the unique ID in bytes for the rollback protection.

config DOOR_LOCK_INTERNAL_ZMS_ROLLBACK_PROTECTION_UNIQUE_ID_UID
	hex "Unique ID UID"
	default 0x00000005FFFFFFFE
	help
		PSA Protected Storage UID for the device Unique ID (internal flash).
		This must be distinct from CONFIG_DOOR_LOCK_EXTERNAL_NVS_ROLLBACK_PROTECTION_UNIQUE_ID_UID.

endif # DOOR_LOCK_INTERNAL_ZMS_ROLLBACK_PROTECTION

config DOOR_LOCK_INTERNAL_ZMS_SHELL
	bool "Shell commands for Internal ZMS"
	depends on SHELL
	help
	  Enable shell commands for the Internal ZMS storage.

endif # DOOR_LOCK_INTERNAL_ZMS
```

## west.yml
```yaml
# Copyright (c) 2025 Nordic Semiconductor ASA
# SPDX-License-Identifier: Apache-2.0

manifest:
  self:
    west-commands: scripts/west-commands.yml
  remotes:
    - name: ncs
      url-base: https://github.com/nrfconnect
    - name: ncs-ssh
      url-base: git@github.com:nrfconnect
    - name: nrfconnect-uwb-qorvo
      url-base: git@gitlab.com:qorvo/qswg/public
    - name: ncs-customization
      url-base: https://github.com/lats1980
  projects:
    - name: nrf
      remote: ncs
      repo-path: sdk-nrf
      revision: v3.2.0
      import: true
    - name: nrfconnect-sdk-qorvo
      remote: nrfconnect-uwb-qorvo
      repo-path: nrfconnect-uwb-sdk
      revision: QM35ALIRO_ENG-0.6.1
      groups:
        - nrfconnect-sdk-qorvo
    - name: matter
      remote: ncs-customization
      repo-path: sdk-connectedhomeip
      path: modules/lib/matter
      # v3.2-door-lock-app-split
      revision: 8905bee9ab388d7ce21765c446e6e8a722476513
      west-commands: scripts/west/west-commands.yml
      submodules:
        - name: nlio
          path: third_party/nlio/repo
        - name: nlassert
          path: third_party/nlassert/repo
        - name: pigweed
          path: third_party/pigweed/repo
        - name: jsoncpp
          path: third_party/jsoncpp/repo
      userdata:
        ncs:
          upstream-url: https://github.com/project-chip/connectedhomeip
          upstream-sha: 181b0cb14ff007ec912f2ba6627e05dfb066c008
          compare-by-default: false
    - name: ncs-door-lock-app-extensions
      remote: ncs-ssh
      repo-path: ncs-door-lock-app-extensions
      revision: v1.0.0
      groups:
        - ncs-door-lock-app-extensions
  group-filter:
    - -nrfconnect-sdk-qorvo
    - -ncs-door-lock-app-extensions
```
